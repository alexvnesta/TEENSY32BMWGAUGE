#include "globals.h"
#include "init_screen.h"
#include "boost_gauge.h"
#include "oil_gauge.h"
#include "canInit.h"
#include "parseCan.h"
#include "multi_gauge.h"
#include "cartesian_graph.h"
#include "zero_sixty.h"
#include "logo_gauge.h"

int number_of_screens = 6;

void initScreen(){
  Serial.println("initializeing screen!");
  u8g2.begin();
}

void drawBootLogo(){

  Serial.println("Drawing Boot Logo");
  #define bmwLogo_width 64
  #define bmwLogo_height 64

static const unsigned char bmwLogo_bits[] PROGMEM = {
   0x00, 0x00, 0x00, 0xfc, 0x3f, 0x00, 0x00, 0x00, 0x00, 0x00, 0xc0, 0x03,
   0xc0, 0x03, 0x00, 0x00, 0x00, 0x00, 0x38, 0x00, 0x00, 0x1c, 0x00, 0x00,
   0x00, 0x00, 0x06, 0xfe, 0x7f, 0x60, 0x00, 0x00, 0x00, 0x00, 0xc1, 0xc7,
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   0x00, 0x00, 0x00, 0xfc, 0x3f, 0x00, 0x00, 0x00 };
  if (setupInitScreen == true){
  drawDisplayOn();
  u8g2.firstPage();
  do {
    u8g2.drawXBMP(33, 0, bmwLogo_width, bmwLogo_height, bmwLogo_bits);
  } while ( u8g2.nextPage() );
  setupInitScreen == false;
  }
}

void drawDisplayOff(){
  Serial.println("Shutting off screen!");
  u8g2.setPowerSave(1);  
}

void drawDisplayOn(){
  Serial.println("Turning on screen!");

  u8g2.setPowerSave(0);  
}

void adjustBrightnessU8G2(){
    if (dimmer == 0) u8g2.setContrast(0);
    else if (dimmer == 1) u8g2.setContrast(0);
    else if (dimmer == 2) u8g2.setContrast(0);
    else if (dimmer == 3) u8g2.setContrast(0);
    else if (dimmer == 4) u8g2.setContrast(0);
    else if (dimmer == 5) u8g2.setContrast(50);
    else if (dimmer == 6) u8g2.setContrast(100);
    else if (dimmer == 7) u8g2.setContrast(175);
    else if (dimmer == 8) u8g2.setContrast(220);
    else if (dimmer == 9) u8g2.setContrast(255);
    else if (dimmer == 10) u8g2.setContrast(255);
}



void switchScreens(int current_screen){
  if (setupInitScreen == false && current_screen != 5 && current_screen != 6) adjustBrightnessU8G2();

  if (current_screen == 0){
    Serial.println("Current Screen Selection is 0");
    drawBootLogo();
  }
  else if (current_screen == 1){
    Serial.println("Current Screen Selection is 1");
    drawBoostGauge();
  }
  else if (current_screen == 2){
    Serial.println("Current Screen Selection is 2");
    drawOilGauge();
  }
  else if (current_screen == 3){
    Serial.println("Current Screen Selection is 3");
    drawLogoGauge();
  }
  else if (current_screen == 4){
    Serial.println("Current Screen Selection is 4");
    drawGraph();
  }
  else if (current_screen == 5){
    Serial.println("Current Screen Selection is 5");
    drawZeroSixty();
  }
  else if (current_screen == 6){
    Serial.println("Current Screen Selection is 6");
    if (setupInitScreen == true){
      drawDisplayOff();
      setupInitScreen = false;
    }
  }
}
