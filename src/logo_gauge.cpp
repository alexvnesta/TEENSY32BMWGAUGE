#define torque_bmp_height 30
#define torque_bmp_witch 30
static const unsigned char torque_bmp[] = {   
   0x00, 0x00, 0x00, 0x00, 0x00, 0x00, 0x08, 0x00, 0x00, 0x00, 0x18, 0x00,
   0x00, 0x00, 0x72, 0x00, 0x00, 0x00, 0x46, 0x00, 0x00, 0x00, 0xcc, 0x01,
   0x00, 0xc0, 0x18, 0x01, 0x00, 0xe0, 0x33, 0x07, 0x00, 0xf0, 0x63, 0x0c,
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   0xcc, 0x00, 0x00, 0x00, 0x78, 0x00, 0x00, 0x00, 0x30, 0x00, 0x00, 0x00 };

#define boost_bmp_width 30
#define boost_bmp_height 30
static unsigned char boost_bmp_bits[] = {
   0x00, 0x00, 0x00, 0x00, 0x00, 0x00, 0x00, 0x00, 0x00, 0x00, 0x80, 0x1f,
   0x00, 0xff, 0xff, 0x10, 0x80, 0x01, 0x80, 0x10, 0x40, 0x00, 0x80, 0x10,
   0x20, 0x00, 0x80, 0x10, 0x10, 0x00, 0x80, 0x10, 0x08, 0x00, 0x80, 0x10,
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   0x00, 0x78, 0x00, 0x00, 0x00, 0x00, 0x00, 0x00, 0x00, 0x00, 0x00, 0x00 };

#define oilpress_bmp_width 30
#define oilpress_bmp_height 30
static unsigned char oilpress_bmp[] = {
   0x00, 0x20, 0x01, 0x00, 0x00, 0x22, 0x11, 0x00, 0x40, 0x24, 0x89, 0x00,
   0x80, 0x24, 0x49, 0x00, 0x10, 0x29, 0x25, 0x02, 0x20, 0x00, 0x00, 0x01,
   0x00, 0x00, 0x00, 0x00, 0x00, 0x00, 0x00, 0x00, 0x00, 0x00, 0x00, 0x00,
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   0x40, 0x24, 0x89, 0x00, 0x00, 0x24, 0x09, 0x00, 0x00, 0x22, 0x11, 0x00 };

#define coolant_bmp_width 30
#define coolant_bmp_height 30
static unsigned char coolant_bmp_bits[] = {
   0x00, 0x00, 0x00, 0x00, 0x00, 0xc0, 0x00, 0x00, 0x00, 0xe0, 0x01, 0x00,
   0x00, 0xe0, 0x01, 0x00, 0x00, 0xe0, 0x07, 0x00, 0x00, 0xe0, 0x01, 0x00,
   0x00, 0xe0, 0x01, 0x00, 0x00, 0xe0, 0x07, 0x00, 0x00, 0xe0, 0x01, 0x00,
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   0x00, 0x00, 0x00, 0x00, 0x00, 0x00, 0x00, 0x00, 0x00, 0x00, 0x00, 0x00 };

#include "globals.h"
#include "boost_gauge.h"
#include "oil_gauge.h"
#include "parseCan.h"
#include "logo_gauge.h"

unsigned long multigaugeMillisLogo = 0;
unsigned long multigaugeStartMillisLogo = 0;

float boostValueLogo = 0;
float oilValueLogo = 0;

void drawLogoGauge(void){
    if (setupInitScreen == true){
    initScreen();
    setupInitScreen = false;
    }

    multigaugeMillisLogo = millis();

    if (multigaugeMillisLogo - multigaugeStartMillisLogo > 100) {
        boostValueLogo = normaliseSensorData(analogRead(20))/100;
        oilValueLogo = normaliseOilSensorData(analogRead(19))/100;

        Serial.print("boostValue : ");
        Serial.println(boostValueLogo);
        Serial.print("oilValue : ");
        Serial.println(oilValueLogo);

        multigaugeStartMillisLogo = millis();
    }

    u8g2.firstPage();
    do {
      u8g2.setFont(u8g2_font_logisoso16_tn);
      u8g2.drawXBMP(0, 0, boost_bmp_width, boost_bmp_height, boost_bmp_bits);
      u8g2.setCursor(32,24);
      u8g2.print((int)boostValueLogo);

      u8g2.drawXBMP(60, 0, torque_bmp_witch, torque_bmp_height, torque_bmp);
      u8g2.setCursor(94,24);
      u8g2.print((int)torquelbf);


      u8g2.drawXBMP(0, 32, oilpress_bmp_width, oilpress_bmp_height, oilpress_bmp);
      u8g2.setCursor(32,58);
      u8g2.print((int)oilValueLogo);

      u8g2.drawXBMP(60, 32, coolant_bmp_width, coolant_bmp_height, coolant_bmp_bits);
      u8g2.setCursor(94,58);
      u8g2.print((int)coolantF);
  } while ( u8g2.nextPage() );


}
